// Copyright 2021 Manna Harbour
// https://github.com/manna-harbour/miryoku

#include "../miryoku/keys_de.h"
#include "../miryoku/custom_config.h"
#include "../miryoku/mapping/42/corne.h"
#include "../miryoku/miryoku.dtsi"

/ {
    keymap {
        de_layer {
            display-name = "DE";
            bindings = <
                &trans  &trans          &trans          &trans  &trans  &trans      &trans  &kp DE_U_UMLAUT &trans  &kp DE_O_UMLAUT &trans  &trans
                &trans  &kp DE_A_UMLAUT &kp DE_SHARP_S  &trans  &trans  &trans      &trans  &trans          &trans  &trans          &trans  &trans
                &trans  &trans          &trans          &trans  &trans  &trans      &trans  &trans          &trans  &trans          &trans  &trans
                                                        &trans  &trans  &trans      &trans  &trans          &trans
            >;
        };
    };
};